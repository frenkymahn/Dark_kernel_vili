## arch/arm64/configs/umi_user_defconfig
```kconfig
vendor/umi_user_defconfig

CONFIG_NAMESPACES=y
CONFIG_PID_NS=y
CONFIG_IPC_NS=y
CONFIG_USER_NS=y
CONFIG_NET_NS=y
CONFIG_CGROUPS=y
CONFIG_DEVTMPFS=y
CONFIG_OVERLAY_FS=y
CONFIG_ISCSI_TARGET=y
```
